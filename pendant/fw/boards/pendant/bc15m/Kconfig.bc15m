## pendant/fw/boards/pendant/bc15m/Kconfig.defconfig
```kconfig
if BOARD_BC15M_NRF54L15_CPUAPP

config HAS_BT_CTLR
	default BT

endif # BOARD_BC15M_NRF54L15_CPUAPP
```

## pendant/fw/boards/pendant/bc15m/bc15m_nrf54l15_cpuapp_defconfig
```kconfig
CONFIG_SERIAL=y
CONFIG_CONSOLE=y
CONFIG_UART_CONSOLE=y

CONFIG_GPIO=y

CONFIG_ARM_MPU=y
CONFIG_HW_STACK_PROTECTION=y
CONFIG_NULL_POINTER_EXCEPTION_DETECTION_NONE=y

CONFIG_CACHE_MANAGEMENT=y
CONFIG_EXTERNAL_CACHE=y

CONFIG_NRF_GRTC_START_SYSCOUNTER=y

CONFIG_REGULATOR=y
CONFIG_REGULATOR_FIXED_INIT_PRIORITY=45

CONFIG_PM_DEVICE=y
CONFIG_NRFX_POWER=y

CONFIG_MPSL_HFCLK_LATENCY=1400
CONFIG_CLOCK_CONTROL_NRF_K32SRC_20PPM=y
```

## pendant/fw/boards/pendant/bc15m/board.yml
```yaml
board:
  name: bc15m
  full_name: Fanstel BC15M
  vendor: pendant
  socs:
    - name: nrf54l15
```
